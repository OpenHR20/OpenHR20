//////////////////////////////////////////////////////////////////////////////

#include "config.h"
#include "rfm.h"

#if (RFM==1)



uint8_t rfm_framebuf[RFM_FRAME_MAX];
uint8_t rfm_framesize = 0;
uint8_t rfm_framepos = 0;
bool rfm_txmode = false;

/*!
 *******************************************************************************
 *  RFM SPI access
 *  \note does the SPI clockin clockout stuff
 *  \param outval the value that shall be clocked out to the RFM
 *  \returns the value that is clocked in from the RFM
 *   
 ******************************************************************************/
uint16_t rfm_spi16(uint16_t outval)
{
  uint16_t i;
  uint16_t ret=0;
  
  RFM_SPI_SELECT;

  for (i=0x8000;i!=0;i>>=1)
  {
    if (i & outval)
    {
      RFM_SPI_MOSI_HIGH;
    }
    else
    {
      RFM_SPI_MOSI_LOW;
    }

    RFM_SPI_SCK_HIGH;
    {
      ret >>= 1;
      if (RFM_SPI_MISO_GET)
      {
	    ret |= i;
      }
    }
    RFM_SPI_SCK_LOW;
  }
  
  RFM_SPI_DESELECT;
  return(ret);
}


///////////////////////////////////////////////////////////////////////////////
//
// Initialise RF module
//
///////////////////////////////////////////////////////////////////////////////

void RFM_init(void)
{
	/////////////////////////////////////////////////////////////////////////////
	//
	// 0. Init the SPI backend
	//
	/////////////////////////////////////////////////////////////////////////////

	//RFM_TESTPIN_INIT;

	RFM_READ_STATUS();

	/////////////////////////////////////////////////////////////////////////////
	//
	// 1. Configuration Setting Command
	//
	/////////////////////////////////////////////////////////////////////////////

	RFM_SPI_16(
		RFM_CONFIG_EL           |
		RFM_CONFIG_EF           |
		RFM_CONFIG_BAND_868     |
		RFM_CONFIG_X_12_0pf  
	 );

	/////////////////////////////////////////////////////////////////////////////
	//
	// 2. Power Management Command 
	//
	/////////////////////////////////////////////////////////////////////////////

	//RFM_SPI_16(
	//	 RFM_POWER_MANAGEMENT     // switch all off
	//	 );

	/////////////////////////////////////////////////////////////////////////////
	//
	// 3. Frequency Setting Command
	//
	/////////////////////////////////////////////////////////////////////////////

	RFM_SPI_16(
		RFM_FREQUENCY            | 
		RFM_FREQ_868Band(868.35)
	 );

	/////////////////////////////////////////////////////////////////////////////
	//
	// 4. Data Rate Command
	//
	/////////////////////////////////////////////////////////////////////////////

	RFM_SPI_16(RFM_SET_DATARATE(RFM_BAUD_RATE));

	/////////////////////////////////////////////////////////////////////////////
	//
	// 5. Receiver Control Command
	//
	/////////////////////////////////////////////////////////////////////////////

	RFM_SPI_16(
		RFM_RX_CONTROL_P20_VDI  | 
		RFM_RX_CONTROL_VDI_FAST |
		RFM_RX_CONTROL_BW(RFM_BAUD_RATE) |
		RFM_RX_CONTROL_GAIN_0   |
		RFM_RX_CONTROL_RSSI_61
	 );

	/////////////////////////////////////////////////////////////////////////////
	//
	// 6. Data Filter Command
	//
	/////////////////////////////////////////////////////////////////////////////

	RFM_SPI_16(
		RFM_DATA_FILTER_AL      |
		RFM_DATA_FILTER_ML      |
		RFM_DATA_FILTER_DQD(3)             
	 );

	/////////////////////////////////////////////////////////////////////////////
	//	 
	// 7. FIFO and Reset Mode Command
	//
	/////////////////////////////////////////////////////////////////////////////

	RFM_SPI_16(
		RFM_FIFO_IT(8) |
		RFM_FIFO_DR
	 );

	/////////////////////////////////////////////////////////////////////////////
	//
	// 8. Receiver FIFO Read
	//
	/////////////////////////////////////////////////////////////////////////////

	/////////////////////////////////////////////////////////////////////////////
	//
	// 9. AFC Command
	//
	/////////////////////////////////////////////////////////////////////////////

	RFM_SPI_16(
		RFM_AFC_AUTO_VDI        |
		RFM_AFC_RANGE_LIMIT_7_8 |
		RFM_AFC_EN              |
		RFM_AFC_OE              |
		RFM_AFC_FI     
	 );


	/////////////////////////////////////////////////////////////////////////////
	//
	// 10. TX Configuration Control Command
	//
	/////////////////////////////////////////////////////////////////////////////

	RFM_SPI_16(
		RFM_TX_CONTROL_MOD(RFM_BAUD_RATE) |
		RFM_TX_CONTROL_POW_0
	 );

	/////////////////////////////////////////////////////////////////////////////
	//
	// 11. Transmitter Register Write Command
	//
	/////////////////////////////////////////////////////////////////////////////

	/////////////////////////////////////////////////////////////////////////////
	//
	// 12. Wake-Up Timer Command
	//
	/////////////////////////////////////////////////////////////////////////////

	/////////////////////////////////////////////////////////////////////////////
	//
	// 13. Low Duty-Cycle Command
	//
	/////////////////////////////////////////////////////////////////////////////

	/////////////////////////////////////////////////////////////////////////////
	//
	// 14. Low Battery Detector Command
	//
	/////////////////////////////////////////////////////////////////////////////

	//RFM_SPI_16(
	//	 RFM_LOW_BATT_DETECT |
	//	 3      // 2.2V + v * 0.1V
	//	 );

	/////////////////////////////////////////////////////////////////////////////
	//
	// 15. Status Read Command
	//
	/////////////////////////////////////////////////////////////////////////////
}

///////////////////////////////////////////////////////////////////////////////


#endif // ifdef RFM

